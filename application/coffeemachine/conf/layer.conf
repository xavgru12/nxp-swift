## application/coffeemachine/conf/layer.conf
```bitbake
# We have a conf and classes directory, add to BBPATH
BBPATH .= ":${LAYERDIR}"

# We have recipes-* directories, add to BBFILES
BBFILES += "${LAYERDIR}/recipes-*/*/*.bb \
            ${LAYERDIR}/recipes-*/*/*.bbappend"

BBFILE_COLLECTIONS += "coffeemachine"
BBFILE_PATTERN_coffeemachine = "^${LAYERDIR}/"
BBFILE_PRIORITY_coffeemachine = "6"

LAYERDEPENDS_coffeemachine = "core"
LAYERSERIES_COMPAT_coffeemachine = "scarthgap"
```

## nxp/conf/local.conf
```bitbake
MACHINE ??= 'imx8mnevk'
DISTRO ?= 'fsl-imx-xwayland'
EXTRA_IMAGE_FEATURES ?= "debug-tweaks"
USER_CLASSES ?= "buildstats"
PATCHRESOLVE = "noop"
BB_DISKMON_DIRS ??= "\
    STOPTASKS,${TMPDIR},1G,100K \
    STOPTASKS,${DL_DIR},1G,100K \
    STOPTASKS,${SSTATE_DIR},1G,100K \
    STOPTASKS,/tmp,100M,100K \
    HALT,${TMPDIR},100M,1K \
    HALT,${DL_DIR},100M,1K \
    HALT,${SSTATE_DIR},100M,1K \
    HALT,/tmp,10M,1K"
PACKAGECONFIG:append:pn-qemu-system-native = " sdl"
CONF_VERSION = "2"

DL_DIR ?= "${BSPDIR}/downloads/"
ACCEPT_FSL_EULA = "1"

IMAGE_INSTALL:append = " helloworld"

#install swift related packages globally(without having to mess with swift meta layer)
IMAGE_INSTALL:append = " libc-dev libgcc-dev icu-dev libstdc++-dev libstdc++ libc-dev zlib-dev curl-dev libxml2-dev systemd-dev"

# libc6-dev 
# libgcc-9-dev 
# libicu-dev 
# libstdc++-9-dev
# libstdc++6
# linux-libc-dev
# zlib1g-dev
# libcurl4-openssl-dev
# libxml2-dev
# libsystemd-dev 

# Switch to Debian packaging and include package-management in the image
PACKAGE_CLASSES = "package_deb"
EXTRA_IMAGE_FEATURES += "package-management"
```
